## nemu/src/memory/Kconfig
```kconfig
menu "Memory Configuration"

config MBASE
  hex "Memory base address"
  default 0x0        if TARGET_SHARE_YSYXSOC
  default 0x0        if ISA_x86
  default 0x80000000 if TARGET_SHARE || TARGET_NATIVE_ELF

config MSIZE
  hex "Memory size"
  default 0xc0000000 if TARGET_SHARE_YSYXSOC
  default 0x8000000  if TARGET_SHARE || TARGET_NATIVE_ELF

config PC_RESET_OFFSET
  hex "Offset of reset vector from the base of memory"
  default 0x100000 if ISA_x86
  default 0

choice
  prompt "Physical memory definition"
  default PMEM_MALLOC if TARGET_SHARE_YSYXSOC
  default PMEM_GARRAY if TARGET_SHARE || TARGET_NATIVE_ELF
config PMEM_MALLOC
  bool "Using malloc()"
config PMEM_GARRAY
  depends on !TARGET_AM && !TARGET_SHARE_YSYXSOC
  bool "Using global array"
endchoice

config MEM_RANDOM
  depends on MODE_SYSTEM && !DIFFTEST && !TARGET_AM && !TARGET_SHARE_YSYXSOC
  bool "Initialize the memory with random values"
  default y
  help
    This may help to find undefined behaviors.

endmenu #MEMORY
```
